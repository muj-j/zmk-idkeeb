## boards/shields/idkeeb/Kconfig.shield
```kconfig
# No whitespace after the comma or in your part name!
config SHIELD_IDKEEB_LEFT
    def_bool $(shields_list_contains,idkeeb_left)

# No whitespace after the comma or in your part name!
config SHIELD_IDTKEEB_RIGHT
    def_bool $(shields_list_contains,idkeeb_right)

# No whitespace after the comma or in the keyboard name!
config SHIELD_IDKEEB_DONGLE
    def_bool $(shields_list_contains,idkeeb_dongle)
```
